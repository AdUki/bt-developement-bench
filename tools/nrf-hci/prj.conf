## CMakeLists.txt
```
# The bench's HCI controller firmware for a Nordic nRF54L15 DK (docs/system.md "An nRF54L15 DK as
# the controller"): Zephyr's hci_uart sample as it is, from the Zephyr workspace, plus the one
# thing it lacks for a Linux host, a public address (src/addr.c). Built by `make nrf-hci`.
cmake_minimum_required(VERSION 3.28.0)

find_package(Zephyr REQUIRED HINTS $ENV{ZEPHYR_BASE})
project(btbench_hci)

target_sources(app PRIVATE ${ZEPHYR_BASE}/samples/bluetooth/hci_uart/src/main.c src/addr.c)
```

## prj.conf
```kconfig
# The bench's HCI controller firmware for a Nordic nRF54L15 DK: Zephyr's hci_uart sample
# (samples/bluetooth/hci_uart) with Zephyr's own open-source link layer (BT_LL_SW_SPLIT), built by
# `make nrf-hci` (docs/system.md "An nRF54L15 DK as the controller"). The board overlay puts HCI
# H:4 on uart20 at 1 Mbaud with flow control, which the DK's on-board J-Link routes to the second
# of its two USB CDC ACM ports (interface 02).
#
# The first block is the sample's prj.conf: no console (the UART carries HCI), HCI raw. What
# follows is what the bench needs from a controller: extended and periodic advertising with PAST
# both ways, Coded PHY, and every isochronous role (BIG source and sink, CIS central and
# peripheral) for LE Audio. Direction finding is left out: it needs antenna switching pins the DK
# has nothing wired to. Everything else follows the sample's overlay-all-bt_ll_sw_split.conf,
# including the buffer counts, so a problem can be compared against the sample as is.

CONFIG_CONSOLE=n
CONFIG_STDOUT_CONSOLE=n
CONFIG_UART_CONSOLE=n
CONFIG_GPIO=y
CONFIG_SERIAL=y
CONFIG_UART_INTERRUPT_DRIVEN=y
CONFIG_SYSTEM_WORKQUEUE_STACK_SIZE=512
CONFIG_BT_MAX_CONN=16

CONFIG_BT=y
CONFIG_BT_HCI_RAW=y

# HCI buffers: 255-byte commands and events, 251-byte ACL (LE data length maximum).
CONFIG_BT_BUF_CMD_TX_SIZE=255
CONFIG_BT_BUF_EVT_RX_COUNT=16
CONFIG_BT_BUF_EVT_RX_SIZE=255
CONFIG_BT_BUF_ACL_TX_COUNT=3
CONFIG_BT_BUF_ACL_TX_SIZE=251
CONFIG_BT_BUF_ACL_RX_COUNT_EXTRA=1
CONFIG_BT_BUF_ACL_RX_SIZE=255

# Host-side switches the controller's features depend on (there is no host here, only HCI raw).
CONFIG_BT_EXT_ADV=y
CONFIG_BT_PER_ADV=y
CONFIG_BT_PER_ADV_SYNC=y
CONFIG_BT_PER_ADV_SYNC_MAX=2
CONFIG_BT_CENTRAL=y
CONFIG_BT_PERIPHERAL=y

# Broadcast and connected ISO.
CONFIG_BT_ISO_BROADCASTER=y
CONFIG_BT_ISO_SYNC_RECEIVER=y
CONFIG_BT_ISO_CENTRAL=y
CONFIG_BT_ISO_PERIPHERAL=y
CONFIG_BT_ISO_TX_MTU=310
CONFIG_BT_ISO_RX_MTU=310
CONFIG_BT_ISO_MAX_CHAN=4
CONFIG_BT_ISO_TX_BUF_COUNT=1
CONFIG_BT_ISO_RX_BUF_COUNT=1

# The controller: Zephyr's link layer, with its assert handler reporting over HCI (a vendor
# fatal-error event instead of a silent hang) and the DTM commands for radio tests.
CONFIG_BT_LL_SW_SPLIT=y
CONFIG_BT_CTLR_DTM_HCI=y
CONFIG_BT_CTLR_ASSERT_HANDLER=y
CONFIG_BT_HCI_VS_FATAL_ERROR=y

# Rx ACL and advertising reports.
CONFIG_BT_CTLR_RX_BUFFERS=9
CONFIG_BT_CTLR_DATA_LENGTH_MAX=251

CONFIG_BT_CTLR_PHY_CODED=y

# Advertising sets and extended scanning.
CONFIG_BT_CTLR_ADV_EXT=y
CONFIG_BT_CTLR_ADV_SET=3
CONFIG_BT_CTLR_ADV_DATA_LEN_MAX=191
CONFIG_BT_CTLR_SCAN_DATA_LEN_MAX=1650

CONFIG_BT_CTLR_ADVANCED_FEATURES=y
CONFIG_BT_CTLR_ADV_AUX_SET=3
CONFIG_BT_CTLR_ADV_AUX_PDU_BACK2BACK=y
CONFIG_BT_CTLR_ADV_SYNC_SET=3
CONFIG_BT_CTLR_ADV_SYNC_PDU_BACK2BACK=y
CONFIG_BT_CTLR_ADV_DATA_BUF_MAX=6

# Scanning of advertising chains.
CONFIG_BT_CTLR_SCAN_AUX_SET=3
CONFIG_BT_CTLR_LOW_LAT_ULL=y

# Radio time reservation: the BIG keeps the whole of its event, everything else yields.
CONFIG_BT_CTLR_ADV_RESERVE_MAX=n
CONFIG_BT_CTLR_ADV_ISO_RESERVE_MAX=y
CONFIG_BT_CTLR_SYNC_ISO_RESERVE_MAX=n
CONFIG_BT_CTLR_CENTRAL_RESERVE_MAX=n
CONFIG_BT_CTLR_PERIPHERAL_RESERVE_MAX=n
CONFIG_BT_CTLR_PERIPHERAL_ISO_RESERVE_MAX=n
CONFIG_BT_CTLR_EVENT_OVERHEAD_RESERVE_MAX=y
CONFIG_BT_CTLR_SLOT_RESERVATION_UPDATE=n
CONFIG_BT_CTLR_SCAN_UNRESERVED=y
CONFIG_BT_TICKER_NEXT_SLOT_GET_MATCH=y
CONFIG_BT_TICKER_EXT=y
CONFIG_BT_TICKER_EXT_SLOT_WINDOW_YIELD=y

# Control procedures.
CONFIG_BT_CTLR_LLCP_LOCAL_PROC_CTX_BUF_NUM=6

# ISO broadcaster (BIG source) with periodic advertising and PAST sending.
CONFIG_BT_CTLR_ADV_PERIODIC=y
CONFIG_BT_CTLR_SYNC_TRANSFER_SENDER=y
CONFIG_BT_CTLR_ADV_ISO=y
CONFIG_BT_CTLR_ADV_ISO_SEQUENTIAL=y
CONFIG_BT_CTLR_ADV_ISO_INTERLEAVED=y
CONFIG_BT_CTLR_ADV_ISO_SET=2
CONFIG_BT_CTLR_ADV_ISO_STREAM_COUNT=4
CONFIG_BT_CTLR_ADV_ISO_STREAM_MAX=2
CONFIG_BT_CTLR_ADV_ISO_PDU_LEN_MAX=247

# ISO synchronized receiver (BIG sink) with periodic sync and PAST receiving.
CONFIG_BT_CTLR_SYNC_PERIODIC=y
CONFIG_BT_CTLR_SYNC_TRANSFER_RECEIVER=y
CONFIG_BT_CTLR_SYNC_ISO=y
CONFIG_BT_CTLR_SYNC_ISO_SEQUENTIAL=y
CONFIG_BT_CTLR_SYNC_ISO_INTERLEAVED=y
CONFIG_BT_CTLR_SCAN_SYNC_ISO_SET=1
CONFIG_BT_CTLR_SYNC_ISO_STREAM_COUNT=2
CONFIG_BT_CTLR_SYNC_ISO_STREAM_MAX=2
CONFIG_BT_CTLR_SYNC_ISO_PDU_LEN_MAX=251

# Connected ISO: one CIG of two CISes, as central or peripheral.
CONFIG_BT_CTLR_CENTRAL_ISO=y
CONFIG_BT_CTLR_PERIPHERAL_ISO=y
CONFIG_BT_CTLR_CONN_ISO_STREAMS=2
CONFIG_BT_CTLR_CONN_ISO_GROUPS=1
CONFIG_BT_CTLR_CONN_ISO_STREAMS_PER_GROUP=2
CONFIG_BT_CTLR_CONN_ISO_PDU_LEN_MAX=251
CONFIG_BT_CTLR_CONN_ISO_LOW_LATENCY_POLICY=y

# ISO data: 18 Tx buffers of 255 bytes is what the controller reports in LE Read Buffer Size v2.
CONFIG_BT_CTLR_ISOAL_SOURCES=4
CONFIG_BT_CTLR_ISO_TX_BUFFERS=18
CONFIG_BT_CTLR_ISO_TX_BUFFER_SIZE=255
CONFIG_BT_CTLR_ISO_TX_SDU_LEN_MAX=247
CONFIG_BT_CTLR_ISOAL_SINKS=2
CONFIG_BT_CTLR_ISO_RX_BUFFERS=4

CONFIG_BT_CTLR_TX_PWR_DYNAMIC_CONTROL=y

# LE Read ISO Link Quality: the controller's own count of CRC errors, unreceived and unacknowledged
# ISO payloads, to tell a radio problem from a link-layer one.
CONFIG_BT_CTLR_READ_ISO_LINK_QUALITY=y

# Periodic sync: also catch an AUX_SYNC_IND up to 14 ms away from where its SyncInfo offset says
# (a stream195x board's Infineon controller sends it a whole ISO interval, 10 ms, late; the
# BE200 could not sync to it either). The first window grows by this much on each side, capped at
# half the periodic interval; once the first PDU is in, the normal window is used.
CONFIG_BT_CTLR_SYNC_ESTAB_WINDOW_US=14000

# After each periodic and BIG sync, a vendor event (0xb0, 0xb2) with where the first PDU landed
# relative to the announced offset, the events listened to and the CRC failures: the monitor
# decodes them (docs/monitor.md), so a peer with wrong SyncInfo or BIGInfo is seen, not guessed.
CONFIG_BT_CTLR_SYNC_TIMING_EVENTS=y
```

## src/addr.c
```c
/* The controller's public address.
 *
 * Zephyr's link layer boots with the public address 00:00:00:00:00:00, and only a Zephyr vendor
 * command, which Linux never sends, can set one. The kernel refuses to power an adapter that has
 * neither a public nor a static address (-EADDRNOTAVAIL), so bluetoothd could not bring the DK up.
 * The nRF54L15's FICR holds a random static address of the chip's own (the one Zephyr's host uses
 * and VS Read Static Addresses reports); the link layer gets it as its public address before HCI
 * starts. HCI Reset clears only the random address, so it stays for the life of the firmware. It is
 * a static random address worn as public: no IEEE OUI behind it, fine for a bench.
 */
#include <zephyr/init.h>
#include <zephyr/bluetooth/controller.h>
#include <zephyr/bluetooth/hci_vs.h>

/* subsys/bluetooth/controller/hci/hci_internal.h, which is not on an application's include path. */
uint8_t hci_vendor_read_static_addr(struct bt_hci_vs_static_addr addrs[], uint8_t size);

static int public_addr_init(void)
{
	struct bt_hci_vs_static_addr addr;

	if (hci_vendor_read_static_addr(&addr, 1) != 1) {
		return -ENODEV;
	}
	bt_ctlr_set_public_addr(addr.bdaddr.val);
	return 0;
}

SYS_INIT(public_addr_init, APPLICATION, CONFIG_KERNEL_INIT_PRIORITY_DEFAULT);
```
